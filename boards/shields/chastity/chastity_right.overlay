/*
 * Copyright (c) 2024 The ZMK Contributors
 *
 * SPDX-License-Identifier: MIT
 */

#include "chastity.dtsi"

/ {
    chosen {
        zmk,kscan = &kscan0;
    };
};

&default_transform {
    col-offset = <7>;
};

&kscan0 {
    col-gpios
        = <&gpio0 15 GPIO_ACTIVE_HIGH>  // Col 0
        , <&gpio0 6  GPIO_ACTIVE_HIGH>  // Col 1
        , <&gpio0 4  GPIO_ACTIVE_HIGH>  // Col 2
        , <&gpio0 11 GPIO_ACTIVE_HIGH>  // Col 3
        , <&gpio0 0  GPIO_ACTIVE_HIGH>  // Col 4
        , <&gpio1 4  GPIO_ACTIVE_HIGH>  // Col 5
        , <&gpio1 6  GPIO_ACTIVE_HIGH>  // Col 6
        ;
};
