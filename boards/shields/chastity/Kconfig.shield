## boards/shields/chastity/Kconfig.shield
```kconfig
# Copyright (c) 2024 The ZMK Contributors
# SPDX-License-Identifier: MIT

config SHIELD_CHASTITY_LEFT
    def_bool $(shields_list_contains,chastity_left)
    select ZMK_SPLIT
    select ZMK_SPLIT_ROLE_CENTRAL if SHIELD_CHASTITY_LEFT

config SHIELD_CHASTITY_RIGHT
    def_bool $(shields_list_contains,chastity_right)
    select ZMK_SPLIT
    select ZMK_SPLIT_ROLE_PERIPHERAL if SHIELD_CHASTITY_RIGHT
```

## config/boards/shields/chastity/Kconfig.defconfig
```kconfig
if SHIELD_CHASTITY_LEFT

config ZMK_KEYBOARD_NAME
    default "Chastity"

config USB_DEVICE_PRODUCT
    default "Chastity"

config USB_DEVICE_VID
    default 0x1D50

config USB_DEVICE_PID
    default 0x615E

config USB_DEVICE_MANUFACTURER
    default "ZMK Project"

endif
```

## config/boards/shields/chastity/Kconfig.shield
```kconfig
# Copyright (c) 2024 The ZMK Contributors
# SPDX-License-Identifier: MIT

config SHIELD_CHASTITY_LEFT
    def_bool $(shields_list_contains,chastity_left)

config SHIELD_CHASTITY_RIGHT
    def_bool $(shields_list_contains,chastity_right)

if SHIELD_CHASTITY_LEFT || SHIELD_CHASTITY_RIGHT

config ZMK_SPLIT
    default y

endif
```

## config/west.yml
```yaml
manifest:
  remotes:
    - name: zmkfirmware
      url-base: https://github.com/zmkfirmware
  projects:
    - name: zmk
      remote: zmkfirmware
      revision: main
      import: app/west.yml
    - name: chastity-zmk
      url: https://github.com/brad-za/chastity-zmk
      revision: main
  self:
    path: config
```
